/*
 * Potters project test code. COntains functions for the testing of functionality of all sensors and components of 
 * the Potters Pot! All test functions ca be called trhough the serial monitor using specified keys as defined 
 * below. The arduino must be connected to a laptop/PC with the arduino serial monitor open at the default 
 * Baud Rate (9600) as all test logs will be printed there.
 * 
 * DO NOT ENTER MORE THAN ONE KEY AT A TIME AND WAIT FOR A TEST COMPLETION MESSAGE BEFORE TESTING THE
 * NEXT COMPONENT TO AVAOID ANY ERRORS.
 * 
 * @AUTHORS: QP TEAM 2: The Potters
 */

 /*
  * TEST FUNCTION KEYS: Enter the number for each test to execute
  * Bluetooth Functionality tests are not yet implemented
  * 
  * 1: Basic TFT LCD display - bitmap with text
  * 2. Basic Soil Moisture Data Output test
  * 3: Soil Moisture Parameter Check - dry soil
  * 4: Light Intensity Test
  * 5: Plant Food Pump Test - With button
  * 6. Plant Food Pump Test - Without button
  * 
  */

#include <avr/pgmspace.h>
#include <TFT.h>
#include <SPI.h>

const uint8_t Mandrake []PROGMEM = {
0x00, 0x00, 0x00, 0x00, 0x00, 0x00, 0x00, 0x00, 0x00, 0x00, 0x00, 0x00, 0x00, 0x00, 0x00, 0x00,
0x00, 0x00, 0x00, 0x00, 0x00, 0x00, 0x00, 0x00, 0x00, 0x00, 0x00, 0x00, 0x00, 0x00, 0x00, 0x00,
0x00, 0x00, 0x00, 0x00, 0x00, 0x00, 0x00, 0x00, 0x00, 0x00, 0x00, 0x00, 0x00, 0x00, 0x00, 0x00,
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0x00, 0x00, 0x00, 0x00, 0x00, 0x00, 0x00, 0x00, 0x00, 0x00, 0x00, 0x00, 0x00, 0x00, 0x00, 0x00
};

int RESET = 5;
int DC = 9;
int CS = 10;

char health[] = {'H', 'e', 'a', 'l', 't', 'h', ':', ' '};
char level[] = {'L', 'e', 'v', 'e', 'l', ':', ' '};
char happiness[] = {'H', 'a', 'p', 'p', 'i', 'n', 'e', 's', 's', ':', ' '};

float moistureLevel = -1;
int moisturePin = A1;

int motorPin = 2;

int lightPin = A0;
int lightValue = -1;

TFT screen = TFT(CS, DC, RESET);

int testCode;

void setup() 
{
  Serial.begin(9600);
  Serial.println("Setting Everything Up");
  
  screen.begin();
  screen.background(0,0,0);

  pinMode(moisturePin, INPUT);
  pinMode(lightPin, INPUT);
  pinMode(motorPin, OUTPUT);
  
  delay(1000);
}

void loop() 
{
  if(Serial.available() > 0)
  {
    testCode = Serial.read();
    Serial.println("The test code received was: ");
    Serial.println(testCode, DEC);
    switch(testCode)
    {
    case 1: //Basic TFT LCD Display
      screen.drawBitmap(0,0,Mandrake, 128, 160, 0xFFFF);
      delay(10000);
      screen.stroke(0,0,0);
      screen.text(health,1,1);
      screen.text(level, 1, 14);
      screen.text(happiness, 1, 27);
      break;
      
    case '2': //Basic Soil Moisture Data Output
      for (int i = 0; i <= 100; i++) 
      { 
        moistureLevel = moistureLevel + analogRead(moisturePin); 
        delay(1); 
      } 
      moistureLevel = moistureLevel/100.0; 
      Serial.println(moistureLevel); 
      delay(30);
      break;
      
    case 3: //Soil Moisture Parameter Check
      for (int i = 0; i <= 100; i++) 
      { 
        moistureLevel = moistureLevel + analogRead(moisturePin); 
        delay(1); 
      } 
      moistureLevel = moistureLevel/100.0; 
      if(moistureLevel < 500)
      {
        Serial.println("Dry");
      }
      else 
      {
        Serial.println("Moist");
      }
      delay(30);
      break;
    case 4:
      
      break;
    case 5: //Plant Food Pump test without button
      digitalWrite(motorPin, HIGH);
      delay(1000);
      digitalWrite(motorPin, LOW);
      break;
    case 6: //Plant Food Pump test with button
      break;
    default:
      Serial.println("Test code not recognised.");
      break;
  }
  }


}
